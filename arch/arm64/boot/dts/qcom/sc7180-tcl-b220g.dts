// SPDX-License-Identifier: BSD-3-Clause
/*
 * SC7180 TCL Bool 14 Go B220G
 *
 * Copyright (c) 2019, The Linux Foundation. All rights reserved.
 */

/dts-v1/;

#include "sc7180-trogdor.dtsi"

/ {
	model = "TCL Book 14 Go B220G";
	compatible = "tcl,b220g", "qcom,sc7180";
};

